## drivers/iio/chemical/Kconfig
```kconfig
#
# Chemical sensors
#

menu "Chemical Sensors"

config ATLAS_PH_SENSOR
	tristate "Atlas Scientific OEM SM sensors"
	depends on I2C
	select REGMAP_I2C
	select IIO_BUFFER
	select IIO_TRIGGERED_BUFFER
	select IRQ_WORK
	help
	 Say Y here to build I2C interface support for the following
	 Atlas Scientific OEM SM sensors:
	    * pH SM sensor
	    * EC SM sensor
	    * ORP SM sensor

	 To compile this driver as module, choose M here: the
	 module will be called atlas-ph-sensor.

config CCS811
	tristate "AMS CCS811 VOC sensor"
	depends on I2C
    select IIO_BUFFER
    select IIO_TRIGGERED_BUFFER
	help
	  Say Y here to build I2C interface support for the AMS
	  CCS811 VOC (Volatile Organic Compounds) sensor

config IAQCORE
	tristate "AMS iAQ-Core VOC sensors"
	depends on I2C
	help
	  Say Y here to build I2C interface support for the AMS
	  iAQ-Core Continuous/Pulsed VOC (Volatile Organic Compounds)
	  sensors

config SENSIRION_SGPXX
	tristate "Sensirion SGPxx gas sensors"
	depends on I2C
	select CRC8
	select IIO_TRIGGERED_BUFFER if (IIO_BUFFER)
	help
	  Say Y here to build I2C interface support for the following
	  Sensirion SGP gas sensors:
	    * SGP30 gas sensor
	    * SGPC3 gas sensor

	  Also select IIO_BUFFER to enable triggered buffers.

	  To compile this driver as module, choose M here: the
	  module will be called sgpxx.

config VZ89X
	tristate "SGX Sensortech MiCS VZ89X VOC sensor"
	depends on I2C
	help
	  Say Y here to build I2C interface support for the SGX
	  Sensortech MiCS VZ89X VOC (Volatile Organic Compounds)
	  sensors

endmenu
```
